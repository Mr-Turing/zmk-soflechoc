## boards/shields/Kconfig.shield
```kconfig
# Copyright (c) 2020 Ryan Cross
# SPDX-License-Identifier: MIT

config SHIELD_TOFLE_LEFT
    def_bool $(shields_list_contains,tofle_left)

config SHIELD_TOFLE_RIGHT
    def_bool $(shields_list_contains,tofle_right)

config SHIELD_TOFLE_NUMPAD
    def_bool $(shields_list_contains,tofle_numpad)
```

## config/west.yml
```yaml
manifest:
  remotes:
    - name: zmkfirmware
      url-base: https://github.com/zmkfirmware
    - name: petejohanson
      url-base: https://github.com/petejohanson
  projects:
    - name: zmk
      remote: zmkfirmware
      revision: main
      import: app/west.yml
    - name: cirque-input-module
      remote: petejohanson
      revision: main
  self:
    path: config
```
