/*
 * Copyright (c) 2020 Ryan Cross
 *
 * SPDX-License-Identifier: MIT
 */

#include "tofle.dtsi"

&default_transform {
    col-offset = <12>;
};

&kscan0 {
    col-gpios
        = <&pro_micro 10 GPIO_ACTIVE_HIGH>
        , <&pro_micro 16 GPIO_ACTIVE_HIGH>
        , <&pro_micro 14 GPIO_ACTIVE_HIGH>
        , <&pro_micro 15 GPIO_ACTIVE_HIGH>
        ;
};

/ {
    /* THIS only makes keymap binding happy, nothing happens on peripheral side */
	glidepoint1: virtual_input {
		compatible = "zmk,virtual-input";
	};
};
